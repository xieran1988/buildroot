## package/multimedia/faac/Config.in
```kconfig
config BR2_PACKAGE_FAAC
	bool "faac"
	help
		FAAC is an MPEG-4 and MPEG-2 AAC encoder.

		http://www.audiocoding.com/faac.html
```

## package/python-flup/Config.in
```kconfig
config BR2_PACKAGE_PYTHON_FLUP
	bool "python-flup"
	depends on BR2_PACKAGE_PYTHON
	help
		flup: random Python WSGI stuff

		http://trac.saddi.com/flup
```
